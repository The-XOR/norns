## Barboni!/unused/ssd1322 support/Kconfig.merge
```kconfig
config FB_TFT_SSD1322
	tristate "FB driver for the SSD1322 OLED Controller"
	depends on FB_TFT
	help
	  Framebuffer support for SSD1322
```
